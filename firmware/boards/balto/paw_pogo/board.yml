## firmware/boards/balto/paw_pogo/board.yml
```yaml
board:
  name: paw_pogo
  full_name: PAW pogo
  vendor: balto
  socs:
    - name: stm32f411xe
```

## firmware/boards/balto/paw_testboard/board.yml
```yaml
board:
  name: paw_testboard
  full_name: PAW testboard
  vendor: balto
  socs:
    - name: nrf52833
```

## firmware/boards/balto/paw_testboard/paw_testboard_defconfig
```kconfig
CONFIG_ARM_MPU=y
CONFIG_HW_STACK_PROTECTION=y
CONFIG_USE_SEGGER_RTT=y
CONFIG_GPIO=y
CONFIG_SERIAL=y
CONFIG_CONSOLE=y
CONFIG_UART_CONSOLE=y
```

## firmware/boards/balto/ploopy_mouse_nrf/board.yml
```yaml
board:
  name: ploopy_mouse_nrf
  full_name: Ploopy mouse nRF
  vendor: balto
  socs:
    - name: nrf52833
```

## firmware/boards/balto/pmw_testboard/board.yml
```yaml
board:
  name: pmw_testboard
  full_name: PMW testboard
  vendor: balto
  socs:
    - name: nrf52833
```

## firmware/boards/balto/wasd_kbd/board.yml
```yaml
board:
  name: wasd_kbd
  full_name: WASD keyboard
  vendor: balto
  socs:
    - name: stm32c071xx
```

## firmware/boards/balto/wasd_kbd/wasd_kbd_defconfig
```kconfig
CONFIG_USE_SEGGER_RTT=y
CONFIG_CONSOLE=y
CONFIG_RTT_CONSOLE=y
CONFIG_SHELL_BACKEND_RTT=y
CONFIG_GPIO=y
```

## firmware/boards/balto/zalpakka/board.yml
```yaml
board:
  name: zalpakka
  full_name: Zalpakka
  vendor: balto
  socs:
    - name: nrf52832
```

## firmware/boards/negcon_retro.conf
```kconfig
CONFIG_SYSTEM_WORKQUEUE_STACK_SIZE=2048
CONFIG_LOG=n
CONFIG_SHELL_MINIMAL=y
CONFIG_SHELL_VT100_COMMANDS=n

CONFIG_PWM=y
CONFIG_REGULATOR=y
CONFIG_INPUT_THREAD_PRIORITY_OVERRIDE=y
CONFIG_INPUT_THREAD_PRIORITY=10

CONFIG_APP_DEVICE_NAME="neGcon"

CONFIG_CBPRINTF_FP_SUPPORT=y

CONFIG_LED_SHELL=y
CONFIG_REGULATOR_SHELL=y

CONFIG_BT=y

# MCUmgr

CONFIG_ROM_END_OFFSET=0x2000
CONFIG_MCUBOOT_UPDATE_FOOTER_SIZE=0x2000

CONFIG_MCUBOOT_SIGNATURE_KEY_FILE="../git/zephyr-input-hid/keys/negcon-retro-key.pem"

CONFIG_ZCBOR=y
CONFIG_MCUMGR=y
CONFIG_BOOTLOADER_MCUBOOT=y
CONFIG_THREAD_MONITOR=y
CONFIG_MCUMGR_GRP_OS=y
CONFIG_MCUMGR_GRP_OS_ECHO=n
CONFIG_MCUMGR_GRP_OS_TASKSTAT=n
CONFIG_MCUMGR_GRP_SHELL=y
CONFIG_SHELL_BACKEND_DUMMY=y
CONFIG_SHELL_BACKEND_DUMMY_BUF_SIZE=1536
CONFIG_MCUBOOT_SHELL=y

CONFIG_MCUMGR_GRP_IMG=y
CONFIG_MCUMGR_GRP_ZBASIC=y
CONFIG_MCUMGR_GRP_ZBASIC_STORAGE_ERASE=y
CONFIG_IMG_MANAGER=y

CONFIG_BT_L2CAP_TX_MTU=498
CONFIG_BT_BUF_ACL_RX_SIZE=502
CONFIG_BT_BUF_ACL_TX_SIZE=502
CONFIG_BT_CTLR_DATA_LENGTH_MAX=251

CONFIG_MCUMGR_TRANSPORT_BT=y
CONFIG_MCUMGR_TRANSPORT_BT_PERM_RW=y
CONFIG_MCUMGR_TRANSPORT_BT_CONN_PARAM_CONTROL=y

CONFIG_MCUMGR_TRANSPORT_BT_REASSEMBLY=y
CONFIG_MCUMGR_TRANSPORT_NETBUF_SIZE=2475
CONFIG_MCUMGR_GRP_OS_MCUMGR_PARAMS=y
```

## firmware/boards/nrf52840dongle.conf
```kconfig
#CONFIG_BT=y
CONFIG_USB_DEVICE_STACK=n
CONFIG_USB_DEVICE_STACK_NEXT=y
#CONFIG_APP_VID=0x045e
#CONFIG_APP_PID=0x028e
```

## firmware/boards/nrf52dk_nrf52832.conf
```kconfig
CONFIG_SERIAL=y
CONFIG_SHELL_BACKEND_SERIAL=y
CONFIG_UART_CONSOLE=y
CONFIG_CONSOLE=y
CONFIG_REGULATOR=y
CONFIG_BT=y
CONFIG_APP_BT_EMPTY_AD_BONDED=y
```

## firmware/boards/paw_g3.conf
```kconfig
CONFIG_SHELL_BACKEND_RTT=y
CONFIG_SHELL_TAB=y
CONFIG_SHELL_VT100_COMMANDS=y
CONFIG_CONSOLE=y
CONFIG_BQ274XX_PM=n

CONFIG_APP_DEVICE_NAME="PAW G3"

CONFIG_BT=y
CONFIG_USB_DEVICE_STACK=n
CONFIG_USB_DEVICE_STACK_NEXT=y
```

## firmware/boards/paw_pogo.conf
```kconfig
CONFIG_SETTINGS=n

CONFIG_SERIAL=y
CONFIG_SHELL_BACKEND_SERIAL=y
CONFIG_UART_CONSOLE=y
CONFIG_CONSOLE=y

CONFIG_USB_DEVICE_STACK=n
CONFIG_USB_DEVICE_STACK_NEXT=y

CONFIG_PM_DEVICE_RUNTIME=n
```

## firmware/boards/ploopy_mouse_nrf.conf
```kconfig
CONFIG_SYSTEM_WORKQUEUE_STACK_SIZE=2048
CONFIG_LOG=n
CONFIG_SHELL_MINIMAL=y
CONFIG_SHELL_VT100_COMMANDS=n

CONFIG_REGULATOR=y

CONFIG_APP_DEVICE_NAME="Ploopy Mouse nRF"

CONFIG_BT=y
CONFIG_USB_DEVICE_STACK=n
CONFIG_USB_DEVICE_STACK_NEXT=y

# MCUmgr

CONFIG_MCUBOOT_SIGNATURE_KEY_FILE="../git/zephyr-input-hid/keys/ploopy-mouse-nrf-key.pem"

CONFIG_ZCBOR=y
CONFIG_MCUMGR=y
CONFIG_BOOTLOADER_MCUBOOT=y
CONFIG_THREAD_MONITOR=y
CONFIG_MCUMGR_GRP_OS=y
CONFIG_MCUMGR_GRP_OS_ECHO=n
CONFIG_MCUMGR_GRP_OS_TASKSTAT=n
CONFIG_MCUMGR_GRP_SHELL=y
CONFIG_SHELL_BACKEND_DUMMY=y
CONFIG_SHELL_BACKEND_DUMMY_BUF_SIZE=1536
CONFIG_MCUBOOT_SHELL=y

CONFIG_MCUMGR_GRP_IMG=y
CONFIG_MCUMGR_GRP_ZBASIC=y
CONFIG_MCUMGR_GRP_ZBASIC_STORAGE_ERASE=y
CONFIG_IMG_MANAGER=y

CONFIG_BT_L2CAP_TX_MTU=498
CONFIG_BT_BUF_ACL_RX_SIZE=502
CONFIG_BT_BUF_ACL_TX_SIZE=502
CONFIG_BT_CTLR_DATA_LENGTH_MAX=251

CONFIG_MCUMGR_TRANSPORT_BT=y
CONFIG_MCUMGR_TRANSPORT_BT_PERM_RW=y
CONFIG_MCUMGR_TRANSPORT_BT_CONN_PARAM_CONTROL=y

CONFIG_MCUMGR_TRANSPORT_BT_REASSEMBLY=y
CONFIG_MCUMGR_TRANSPORT_NETBUF_SIZE=2475
CONFIG_MCUMGR_GRP_OS_MCUMGR_PARAMS=y
```

## firmware/boards/wasd_kbd.conf
```kconfig
CONFIG_APP_DEVICE_NAME="WASD Keyboard"
CONFIG_USB_DEVICE_STACK_NEXT=y
CONFIG_APP_USB_REMOTE_WAKEUP=y

CONFIG_PM_DEVICE_RUNTIME=n

CONFIG_SETTINGS=n
CONFIG_NVS=n
CONFIG_WATCHDOG=n

CONFIG_FLASH=y
CONFIG_FLASH_EX_OP_ENABLED=y
CONFIG_FLASH_STM32_OPTION_BYTES=y

CONFIG_LED_STRIP=y
```

## firmware/boards/zalpakka.conf
```kconfig
CONFIG_PWM=y
CONFIG_REGULATOR=y
CONFIG_SENSOR=y
CONFIG_INPUT_QUEUE_MAX_MSGS=32

CONFIG_APP_DEVICE_NAME="Z-Alpakka"

CONFIG_CBPRINTF_FP_SUPPORT=y

CONFIG_LED_SHELL=y
CONFIG_REGULATOR_SHELL=y
CONFIG_SENSOR_SHELL=y

CONFIG_BT=y
```
