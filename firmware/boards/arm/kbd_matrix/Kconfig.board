## firmware/boards/arm/kbd_matrix/kbd_matrix_defconfig
```kconfig
CONFIG_SOC_SERIES_NRF52X=y
CONFIG_SOC_NRF52832_QFAA=y
CONFIG_BOARD_KBD_MATRIX=y
CONFIG_ARM_MPU=y
CONFIG_HW_STACK_PROTECTION=y
CONFIG_GPIO=y
CONFIG_SERIAL=y
CONFIG_CONSOLE=y
CONFIG_UART_CONSOLE=y
```

## firmware/boards/balto/big_stick/board.yml
```yaml
board:
  name: big_stick
  full_name: Big stick
  vendor: balto
  socs:
    - name: nrf52833
```

## firmware/boards/balto/ble_pulse_encoder/board.yml
```yaml
board:
  name: ble_pulse_encoder
  full_name: BLE pulse encoder
  vendor: balto
  socs:
    - name: nrf52832
  revision:
    format: letter
    default: B
    revisions:
      - name: B
      - name: J
```

## firmware/boards/balto/darfon/board.yml
```yaml
board:
  name: darfon
  full_name: Darfon
  vendor: balto
  socs:
    - name: stm32f103xe
```

## firmware/boards/balto/darfon/darfon_defconfig
```kconfig
CONFIG_LOG=y
CONFIG_GPIO=y
CONFIG_SERIAL=y
CONFIG_CONSOLE=y
CONFIG_UART_CONSOLE=y
CONFIG_CLOCK_CONTROL=y
CONFIG_PINCTRL=y
CONFIG_USE_DT_CODE_PARTITION=y
```

## firmware/boards/balto/ds2_retrofit/board.yml
```yaml
board:
  name: ds2_retrofit
  full_name: DS2 retrofit
  vendor: balto
  socs:
    - name: nrf52832
```

## firmware/boards/balto/ds2_retrofit/ds2_retrofit_defconfig
```kconfig
CONFIG_ARM_MPU=y
CONFIG_HW_STACK_PROTECTION=y
CONFIG_USE_SEGGER_RTT=y
CONFIG_GPIO=y
CONFIG_CONSOLE=y
```

## firmware/boards/balto/kbd_matrix/board.yml
```yaml
board:
  name: kbd_matrix
  full_name: Keyboard matrix
  vendor: balto
  socs:
    - name: nrf52832
```

## firmware/boards/balto/negcon-retro/board.yml
```yaml
board:
  name: negcon_retro
  full_name: neGcon retro
  vendor: balto
  socs:
    - name: nrf52832
```

## firmware/boards/balto/paw_g3/board.yml
```yaml
board:
  name: paw_g3
  full_name: PAW G3
  vendor: balto
  socs:
    - name: nrf52833
```
