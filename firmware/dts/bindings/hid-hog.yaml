## firmware/dts/bindings/hid-kbd.yaml
```yaml
description: HID keyboard node

compatible: "hid-kbd"

include: hid-common.yaml

properties:
  nkro:
    type: boolean
```

## firmware/dts/bindings/input-board-filter.yaml
```yaml
description: Board specific input filter

compatible: input-board-filter

properties:
  input:
    type: phandles
    required: true
```

## firmware/dts/bindings/pm-control.yaml
```yaml
description: PM control node

compatible: pm-control

properties:
  always-on:
    type: phandles

  connect-on:
    type: phandles
```

## firmware/dts/bindings/suspend-gpios.yaml
```yaml
description: GPIO suspend state

compatible: suspend-gpios

properties:
  gpios:
    type: phandle-array
```

## firmware/dts/bindings/ti,drv8212.yaml
```yaml
description: DRV8212

compatible: "ti,drv8212"

include: base.yaml

properties:
  mode-gpios:
    type: phandle-array
    required: true

  pwms:
    type: phandle-array
    required: true
```

## firmware/dts/bindings/ti,drv8830.yaml
```yaml
description: DRV8830 Low-Voltage Motor Driver With Serial Interface

compatible: "ti,drv8830"

include: [sensor-device.yaml, i2c-device.yaml]
```

## firmware/dts/bindings/touch-sense.yaml
```yaml
description: Touch sense

compatible: touch-sense

properties:
  drive-gpios:
    type: phandle-array

  sense-gpios:
    type: phandle-array
```

## firmware/dts/bindings/usb-hid.yaml
```yaml
description: USB HID

compatible: "usb-hid"

on-bus: hid

include: base.yaml

properties:
  usb-hid-dev:
    type: phandle
    required: true
```

## firmware/dts/bindings/usb-wakeup.yaml
```yaml
description: USB wakeup

compatible: usb-wakeup

properties:
  input:
    type: phandle

  key-codes:
    type: array
```

## firmware/dts/bindings/xinput.yaml
```yaml
description: xinput

compatible: "xinput"

include: base.yaml

properties:
  input:
    type: phandles
```
